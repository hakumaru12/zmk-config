## boards/shields/hskbd40/Kconfig.defconfig
```kconfig
if SHIELD_HSKBD40_LEFT || SHIELD_HSKBD40_RIGHT

config ZMK_KEYBOARD_NAME
    default "HSKBD40"

endif
```

## boards/shields/hskbd40/Kconfig.shield
```kconfig
if SHIELD_HSKBD40_LEFT

config ZMK_KEYBOARD_NAME
    default "HSKBD40"

config ZMK_SPLIT_ROLE_CENTRAL
    default y

endif

if SHIELD_HSKBD40_LEFT || SHIELD_HSKBD40_RIGHT

config ZMK_SPLIT
    default y

endif
```
